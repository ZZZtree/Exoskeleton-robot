## esp_udp/main/Kconfig.projbuild
```kconfig
menu "Example Configuration"

    config EXAMPLE_CAMERA_VIDEO_BUFFER_NUMBER
        int "Camera video buffer number"
        default 2
        help
            Number of video buffers for the camera sensor.
            More buffers provide better performance and reduce frame drops,
            but consume more memory. Recommended range: 2-4 buffers.

    config EXAMPLE_JPEG_COMPRESSION_QUALITY
        int "JPEG compression quality (%)"
        default 80
        range 1 100
        help
            JPEG compression quality percentage (1-100).
            Higher values produce better image quality but larger data streams.

    config EXAMPLE_HTTP_PART_BOUNDARY
        string "HTTP part boundary"
        default "123456789000000000000987654321"
        help
            HTTP multipart boundary string used for MJPEG streaming.

    config EXAMPLE_MDNS_INSTANCE
        string "mDNS instance"
        default "web-cam"
        help
            mDNS instance name for service discovery.

    config EXAMPLE_MDNS_HOST_NAME
        string "mDNS host name"
        default "esp-web"
        help
            mDNS hostname for the ESP32 device.

    config EXAMPLE_ENABLE_MIPI_CSI_CROP
        bool "Enable crop for MIPI-CSI video device"
        default n
        depends on EXAMPLE_ENABLE_MIPI_CSI_CAM_SENSOR && SOC_ISP_CROP_SUPPORTED

    if EXAMPLE_ENABLE_MIPI_CSI_CROP
        config EXAMPLE_MIPI_CSI_CROP_TOP_LEFT_H
            int "Crop region top-left horizontal coordinate"
            default 0
        config EXAMPLE_MIPI_CSI_CROP_TOP_LEFT_V
            int "Crop region top-left vertical coordinate"
            default 0
        config EXAMPLE_MIPI_CSI_CROP_WIDTH
            int "Crop region width"
            default 640
        config EXAMPLE_MIPI_CSI_CROP_HEIGHT
            int "Crop region height"
            default 480
    endif

    config EXAMPLE_H264_LOOPBACK_TEST
        bool "Enable H.264 loopback test (standalone, no camera needed)"
        default n
        help
            Enable the H.264 UDP loopback test mode.
            Generates synthetic YUV420 test frames, encodes using ESP32-P4 H.264 M2M
            hardware encoder, and sends via UDP to a PC client.

endmenu
```

## esp_udp/sdkconfig.defaults
```kconfig
CONFIG_LWIP_TCPIP_RECVMBOX_SIZE=64
CONFIG_LWIP_TCP_SND_BUF_DEFAULT=65535
CONFIG_LWIP_TCP_WND_DEFAULT=65535
CONFIG_LWIP_TCP_RECVMBOX_SIZE=64
CONFIG_LWIP_MAX_SOCKETS=22

CONFIG_PARTITION_TABLE_CUSTOM=y
CONFIG_PARTITION_TABLE_CUSTOM_FILENAME="partitions.csv"
CONFIG_PARTITION_TABLE_FILENAME="partitions.csv"

CONFIG_VFS_MAX_COUNT=10

CONFIG_EXAMPLE_CONNECT_WIFI=y
CONFIG_CAMERA_OV5647=y
CONFIG_CAMERA_OV5647_AUTO_DETECT_MIPI_INTERFACE_SENSOR=y
CONFIG_CAMERA_OV5647_MIPI_RAW8_800X1280_50FPS=y
CONFIG_CAM_CTRL_SPI_ENABLE=n

# OTA configuration
CONFIG_OTA_ALLOW_HTTP=y
CONFIG_BOOTLOADER_APP_ROLLBACK_ENABLE=y
CONFIG_APP_ROLLBACK_ENABLE=y

# Video device configuration
CONFIG_ESP_VIDEO_ENABLE_HW_H264_VIDEO_DEVICE=y
CONFIG_ESP_VIDEO_ENABLE_HW_JPEG_VIDEO_DEVICE=y
```
